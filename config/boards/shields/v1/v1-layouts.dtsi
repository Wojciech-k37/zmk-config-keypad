// See https://zmk.dev/docs/development/hardware-integration/physical-layouts
// for how to configure this.

#include <physical_layouts.dtsi>

/ {
    // 1. Define the "Key Attribute" helper node
    // This tells ZMK how to read the coordinate numbers
    key_physical_attrs: key_physical_attrs {
        compatible = "zmk,physical-layout-keys";
        #binding-cells = <4>; // We are sending 4 numbers: x, y, w, h
    };

    layouts {
        compatible = "zmk,layouts";
        label = "Layouts";

        default_layout: default_layout {
            compatible = "zmk,physical-layout";
            display-name = "Default Layout";
            transform = <&default_transform>;
            kscan = <&kscan0>;

            // 2. The corrected keys list
            // Notice the "&key_physical_attrs" added before every group of numbers
            keys
            // Row 1
            = <&key_physical_attrs 0 0 100 100>, <&key_physical_attrs 100 0 100 100>, <&key_physical_attrs 200 0 100 100>, <&key_physical_attrs 300 0 100 100>
            // Row 2
            , <&key_physical_attrs 0 100 100 100>, <&key_physical_attrs 100 100 100 100>, <&key_physical_attrs 200 100 100 100>, <&key_physical_attrs 300 100 100 100>
            // Row 3
            , <&key_physical_attrs 0 200 100 100>, <&key_physical_attrs 100 200 100 100>, <&key_physical_attrs 200 200 100 100>, <&key_physical_attrs 300 200 100 100>
            // Row 4
            , <&key_physical_attrs 0 300 100 100>, <&key_physical_attrs 100 300 100 100>, <&key_physical_attrs 200 300 100 100>, <&key_physical_attrs 300 300 100 100>
            // Row 5
            , <&key_physical_attrs 0 400 100 100>, <&key_physical_attrs 100 400 100 100>, <&key_physical_attrs 200 400 100 100>, <&key_physical_attrs 300 400 100 100>
            ;
        };
    };
};
